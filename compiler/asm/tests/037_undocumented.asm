INC  IXH
DEC  IXH
LD   IXH,11
INC  IXL
DEC  IXL
LD   IXL,11
LD   B,IXH
LD   B,IXL
LD   C,IXH
LD   C,IXL
LD   D,IXH
LD   D,IXL
LD   E,IXH
LD   E,IXL
LD   IXH,B
LD   IXH,C
LD   IXH,D
LD   IXH,E
LD   IXH,IXH
LD   IXH,IXL
LD   IXH,A
LD   IXL,B
LD   IXL,C
LD   IXL,D
LD   IXL,E
LD   IXL,IXH
LD   IXL,IXL
LD   IXL,A
LD   A,IXH
LD   A,IXL
ADD  A,IXH
ADD  A,IXL
ADC  A,IXH
ADC  A,IXL
SUB  IXH
SUB  IXL
SBC  A,IXH
SBC  A,IXL
AND  IXH
AND  IXL
XOR  IXH
XOR  IXL
OR   IXH
OR   IXL
CP   IXH
CP   IXL
INC  IYH
DEC  IYH
LD   IYH,11
INC  IYL
DEC  IYL
LD   IYL,11
LD   B,IYH
LD   B,IYL
LD   C,IYH
LD   C,IYL
LD   D,IYH
LD   D,IYL
LD   E,IYH
LD   E,IYL
LD   IYH,B
LD   IYH,C
LD   IYH,D
LD   IYH,E
LD   IYH,IYH
LD   IYH,IYL
LD   IYH,A
LD   IYL,B
LD   IYL,C
LD   IYL,D
LD   IYL,E
LD   IYL,IYH
LD   IYL,IYL
LD   IYL,A
LD   A,IYH
LD   A,IYL
ADD  A,IYH
ADD  A,IYL
ADC  A,IYH
ADC  A,IYL
SUB  IYH
SUB  IYL
SBC  A,IYH
SBC  A,IYL
AND  IYH
AND  IYL
XOR  IYH
XOR  IYL
OR   IYH
OR   IYL
CP   IYH
CP   IYL
